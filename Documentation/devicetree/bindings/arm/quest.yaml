## arch/arm64/configs/qrk3588_defconfig
```kconfig
# SPDX-License-Identifier: GPL-2.0-only
# Copyright (c) 2026 ninozhang001@gmail.com

# CONFIG_LOCALVERSION_AUTO is not set
# CONFIG_CROSS_MEMORY_ATTACH is not set
# CONFIG_CPU_ISOLATION is not set
# CONFIG_SCHED_CACHE is not set
CONFIG_CC_OPTIMIZE_FOR_SIZE=y
CONFIG_EXPERT=y
CONFIG_MULTIUSER=y
# CONFIG_FHANDLE is not set
CONFIG_POSIX_TIMERS=y
CONFIG_PRINTK=y
# CONFIG_BUG is not set
CONFIG_FUTEX=y
# CONFIG_EPOLL is not set
# CONFIG_SIGNALFD is not set
# CONFIG_TIMERFD is not set
# CONFIG_EVENTFD is not set
# CONFIG_SHMEM is not set
# CONFIG_AIO is not set
# CONFIG_IO_URING is not set
# CONFIG_ADVISE_SYSCALLS is not set
# CONFIG_MEMBARRIER is not set
# CONFIG_RSEQ is not set
# CONFIG_CACHESTAT_SYSCALL is not set
# CONFIG_KALLSYMS is not set
CONFIG_ARCH_QRK3588=y
CONFIG_HOTPLUG_CPU=y
CONFIG_VIRTUALIZATION=y
CONFIG_KVM=y
# CONFIG_AMPERE_ERRATUM_AC03_CPU_38 is not set
# CONFIG_AMPERE_ERRATUM_AC04_CPU_23 is not set
# CONFIG_ARM64_ERRATUM_826319 is not set
# CONFIG_ARM64_ERRATUM_827319 is not set
# CONFIG_ARM64_ERRATUM_824069 is not set
# CONFIG_ARM64_ERRATUM_819472 is not set
# CONFIG_ARM64_ERRATUM_832075 is not set
# CONFIG_ARM64_ERRATUM_843419 is not set
# CONFIG_ARM64_ERRATUM_1024718 is not set
# CONFIG_ARM64_ERRATUM_1165522 is not set
# CONFIG_ARM64_ERRATUM_1319367 is not set
# CONFIG_ARM64_ERRATUM_1530923 is not set
# CONFIG_ARM64_ERRATUM_1463225 is not set
# CONFIG_ARM64_ERRATUM_1508412 is not set
# CONFIG_ARM64_ERRATUM_2051678 is not set
# CONFIG_ARM64_ERRATUM_2077057 is not set
# CONFIG_ARM64_ERRATUM_2658417 is not set
# CONFIG_ARM64_ERRATUM_2054223 is not set
# CONFIG_ARM64_ERRATUM_2067961 is not set
# CONFIG_ARM64_ERRATUM_2645198 is not set
# CONFIG_ARM64_ERRATUM_2966298 is not set
# CONFIG_ARM64_ERRATUM_3117295 is not set
# CONFIG_ARM64_ERRATUM_3194386 is not set
# CONFIG_ARM64_ERRATUM_4311569 is not set
# CONFIG_ARM64_ERRATUM_4118414 is not set
# CONFIG_CAVIUM_ERRATUM_22375 is not set
# CONFIG_CAVIUM_ERRATUM_23154 is not set
# CONFIG_CAVIUM_ERRATUM_27456 is not set
# CONFIG_CAVIUM_ERRATUM_30115 is not set
# CONFIG_CAVIUM_TX2_ERRATUM_219 is not set
# CONFIG_FUJITSU_ERRATUM_010001 is not set
# CONFIG_HISILICON_ERRATUM_161600802 is not set
# CONFIG_HISILICON_ERRATUM_162100801 is not set
# CONFIG_HISILICON_ERRATUM_162100125 is not set
# CONFIG_QCOM_FALKOR_ERRATUM_1003 is not set
# CONFIG_QCOM_FALKOR_ERRATUM_1009 is not set
# CONFIG_QCOM_QDF2400_ERRATUM_0065 is not set
# CONFIG_QCOM_FALKOR_ERRATUM_E1041 is not set
# CONFIG_NVIDIA_CARMEL_CNP_ERRATUM is not set
# CONFIG_NVIDIA_OLYMPUS_1027_ERRATUM is not set
# CONFIG_RENESAS_ERRATUM_GEN4GICITS1 is not set
# CONFIG_ROCKCHIP_ERRATUM_3568002 is not set
# CONFIG_ROCKCHIP_ERRATUM_3588001 is not set
# CONFIG_SOCIONEXT_SYNQUACER_PREITS is not set
# CONFIG_UNMAP_KERNEL_AT_EL0 is not set
# CONFIG_MITIGATE_SPECTRE_BRANCH_HISTORY is not set
# CONFIG_ARM64_TAGGED_ADDR_ABI is not set
# CONFIG_ARM64_HW_AFDBM is not set
# CONFIG_ARM64_RAS_EXTN is not set
# CONFIG_ARM64_CNP is not set
# CONFIG_ARM64_PTR_AUTH is not set
# CONFIG_ARM64_AMU_EXTN is not set
# CONFIG_ARM64_TLB_RANGE is not set
# CONFIG_ARM64_BTI is not set
# CONFIG_ARM64_E0PD is not set
# CONFIG_ARM64_EPAN is not set
# CONFIG_ARM64_POE is not set
# CONFIG_ARM64_GCS is not set
# CONFIG_ARM64_LSUI is not set
# CONFIG_ARM64_SVE is not set
# CONFIG_RELOCATABLE is not set
# CONFIG_EFI is not set
# CONFIG_SUSPEND is not set
# CONFIG_SCHED_SMT is not set
# CONFIG_SCHED_CLUSTER is not set
# CONFIG_SCHED_MC is not set
# CONFIG_SECCOMP is not set
# CONFIG_STACKPROTECTOR is not set
# CONFIG_RANDOMIZE_KSTACK_OFFSET is not set
CONFIG_BLOCK=y
CONFIG_ZONE_DMA32=y
CONFIG_PCI=y
CONFIG_PCI_MSI=y
CONFIG_PCIEPORTBUS=y
CONFIG_PCIE_QRK3588=y
CONFIG_PHY_QRK3588_COMBO=y
CONFIG_BINFMT_ELF=y
CONFIG_BINFMT_SCRIPT=y
# CONFIG_COREDUMP is not set
CONFIG_SLUB_TINY=y
CONFIG_NET=y
CONFIG_PACKET=y
CONFIG_UNIX=y
CONFIG_INET=y
CONFIG_IPV6=y
# CONFIG_COMPAT_BRK is not set
# CONFIG_COMPACTION is not set
# CONFIG_ZONE_DMA is not set
# CONFIG_VM_EVENT_COUNTERS is not set
# CONFIG_SECRETMEM is not set
# CONFIG_STANDALONE is not set
# CONFIG_PREVENT_FIRMWARE_BUILD is not set
CONFIG_FW_LOADER=y
CONFIG_DEVTMPFS=y
CONFIG_DEVTMPFS_MOUNT=y
# CONFIG_ALLOW_DEV_COREDUMP is not set
# CONFIG_ARM_SMCCC_SOC_ID is not set
# The two onboard RTL8125BG controllers enumerate on PCIe.
CONFIG_NETDEVICES=y
CONFIG_NET_VENDOR_REALTEK=y
CONFIG_R8169=y
# CONFIG_INPUT is not set
# CONFIG_SERIO is not set
CONFIG_TTY=y
# CONFIG_VT is not set
CONFIG_SERIAL_8250=y
CONFIG_SERIAL_8250_CONSOLE=y
CONFIG_SERIAL_8250_DW=y
CONFIG_SERIAL_OF_PLATFORM=y
CONFIG_RESET_CONTROLLER=y
# CONFIG_HW_RANDOM is not set
# CONFIG_DEVMEM is not set
# CONFIG_DEVPORT is not set
# CONFIG_HWMON is not set
# CONFIG_USB_SUPPORT is not set
# CONFIG_VIRTIO_MENU is not set
# CONFIG_VHOST_MENU is not set
# CONFIG_SURFACE_PLATFORMS is not set
# CONFIG_ARM64_PLATFORM_DEVICES is not set
# CONFIG_ARM_ARCH_TIMER_EVTSTREAM is not set
# CONFIG_FSL_ERRATUM_A008585 is not set
# CONFIG_HISILICON_ERRATUM_161010101 is not set
# CONFIG_ARM64_ERRATUM_858921 is not set
# CONFIG_IOMMU_SUPPORT is not set
CONFIG_FILE_LOCKING=y
# CONFIG_DNOTIFY is not set
# CONFIG_INOTIFY_USER is not set
CONFIG_PROC_FS=y
CONFIG_SYSFS=y
# CONFIG_MISC_FILESYSTEMS is not set
# CONFIG_CRC_OPTIMIZATIONS is not set
# CONFIG_DEBUG_MISC is not set
CONFIG_DEBUG_INFO_COMPRESSED_ZLIB=y
# CONFIG_SECTION_MISMATCH_WARN_ONLY is not set
# CONFIG_RCU_TRACE is not set
# CONFIG_FTRACE is not set
# CONFIG_RUNTIME_TESTING_MENU is not set

# Built-in support for mounting the root filesystem without an initramfs.
CONFIG_IP_PNP=y
CONFIG_IP_PNP_DHCP=y
CONFIG_NFS_FS=y
CONFIG_NFS_V3=y
CONFIG_ROOT_NFS=y

# Built-in eMMC and ext4 root filesystem support.
CONFIG_MMC=y
CONFIG_MMC_BLOCK=y
CONFIG_MMC_SDHCI=y
CONFIG_MMC_SDHCI_PLTFM=y
CONFIG_MMC_SDHCI_QRK3588=y
CONFIG_REGULATOR=y
CONFIG_REGULATOR_FIXED_VOLTAGE=y
CONFIG_EXT4_FS=y
```

## drivers/phy/quest/Kconfig
```kconfig
# SPDX-License-Identifier: GPL-2.0-only

config PHY_QRK3588_COMBO
	tristate "Quest QRK3588 Combo PIPE PHY in PCIe mode"
	depends on OF && (ARCH_QRK3588 || COMPILE_TEST)
	select GENERIC_PHY
	select MFD_SYSCON
	select RESET_CONTROLLER
	help
	  Enable the Combo PIPE PHYs connected to the QRK3588 single-lane
	  PCIe controllers. The driver manages PHY clocks, resets and routing.
```

## drivers/soc/quest/Kconfig
```kconfig
# SPDX-License-Identifier: GPL-2.0-only

config QRK3588_GIC_DIAGNOSTICS
	bool "QRK3588 GIC-600 RAS diagnostics"
	depends on ARCH_QRK3588
	depends on DEBUG_KERNEL
	help
	  Read and report the ITS command-queue registers and GIC-600 RAS
	  records after early interrupt controller initialization. Requires
	  firmware to grant Non-secure access to GICT registers. This is
	  intended for controlled bring-up only and must remain disabled in
	  production images.
```
