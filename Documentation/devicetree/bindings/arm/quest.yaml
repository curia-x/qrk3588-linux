## Documentation/devicetree/bindings/arm/quest.yaml
```yaml
# SPDX-License-Identifier: (GPL-2.0-only OR BSD-2-Clause)
# Copyright (c) 2026 ninozhang001@gmail.com
%YAML 1.2
---
$id: http://devicetree.org/schemas/arm/quest.yaml#
$schema: http://devicetree.org/meta-schemas/core.yaml#

title: Quest QRK3588 platforms

maintainers:
  - QRK3588 maintainers <ninozhang001@gmail.com>

description: |
  Build-only description for the Quest QRK3588 platform. Hardware support is
  intentionally absent until it can be implemented from authoritative
  documentation.

properties:
  $nodename:
    const: '/'
  compatible:
    const: quest,qrk3588

additionalProperties: true

required:
  - compatible

...
```

## Documentation/devicetree/bindings/clock/quest,qrk3588-cru.yaml
```yaml
# SPDX-License-Identifier: (GPL-2.0-only OR BSD-2-Clause)
%YAML 1.2
---
$id: http://devicetree.org/schemas/clock/quest,qrk3588-cru.yaml#
$schema: http://devicetree.org/meta-schemas/core.yaml#

title: Quest QRK3588 clock controller

maintainers:
  - ninozhang001@gmail.com

description: |
  The QRK3588 clock and reset unit supplies clocks for the eMMC, GPIO, PCIe
  and UART blocks. The provider spans the main CRU, PHP-top CRU and PMU1 CRU
  register regions.

properties:
  compatible:
    const: quest,qrk3588-cru

  reg:
    minItems: 3
    maxItems: 3

  reg-names:
    items:
      - const: cru
      - const: phptop-cru
      - const: pmu1-cru

  '#clock-cells':
    const: 1
    description: Clock index defined in quest,qrk3588-cru.h.

  '#reset-cells':
    const: 1
    description: Reset index defined in quest,qrk3588-cru.h.

required:
  - compatible
  - reg
  - reg-names
  - '#clock-cells'
  - '#reset-cells'

additionalProperties: false

examples:
  - |
    clock-controller@fd7c0000 {
        compatible = "quest,qrk3588-cru";
        reg = <0xfd7c0000 0x8000>,
              <0xfd7c8000 0x8000>,
              <0xfd7f0000 0x10000>;
        reg-names = "cru", "phptop-cru", "pmu1-cru";
        #clock-cells = <1>;
        #reset-cells = <1>;
    };
...
```

## Documentation/devicetree/bindings/gpio/quest,qrk3588-gpio.yaml
```yaml
# SPDX-License-Identifier: (GPL-2.0-only OR BSD-2-Clause)
%YAML 1.2
---
$id: http://devicetree.org/schemas/gpio/quest,qrk3588-gpio.yaml#
$schema: http://devicetree.org/meta-schemas/core.yaml#

title: Quest QRK3588 GPIO Controller

maintainers:
  - ninozhang001@gmail.com

description:
  Each QRK3588 GPIO bank provides 32 controller lines. Some line numbers do
  not have a corresponding pad and are excluded with gpio-reserved-ranges.
  GPIO-to-pad mappings are described by gpio-ranges because GPIO2 is not
  entirely linear.

properties:
  compatible:
    const: quest,qrk3588-gpio

  reg:
    maxItems: 1

  clocks:
    maxItems: 1

  clock-names:
    const: pclk

  quest,bank-id:
    $ref: /schemas/types.yaml#/definitions/uint32
    minimum: 0
    maximum: 4
    description: GPIO bank number used for hardware line validation

  gpio-controller: true

  '#gpio-cells':
    const: 2

  gpio-ranges: true

  gpio-reserved-ranges: true

required:
  - compatible
  - reg
  - clocks
  - clock-names
  - quest,bank-id
  - gpio-controller
  - '#gpio-cells'
  - gpio-ranges

additionalProperties: false

examples:
  - |
    gpio@fec20000 {
        compatible = "quest,qrk3588-gpio";
        reg = <0xfec20000 0x10000>;
        clocks = <&cru 6>;
        clock-names = "pclk";
        quest,bank-id = <1>;
        gpio-controller;
        #gpio-cells = <2>;
        gpio-ranges = <&pinctrl 0 32 32>;
    };
...
```

## Documentation/devicetree/bindings/mmc/quest,qrk3588-emmc.yaml
```yaml
# SPDX-License-Identifier: (GPL-2.0-only OR BSD-2-Clause)
%YAML 1.2
---
$id: http://devicetree.org/schemas/mmc/quest,qrk3588-emmc.yaml#
$schema: http://devicetree.org/meta-schemas/core.yaml#

title: Quest QRK3588 eMMC host controller

maintainers:
  - ninozhang001@gmail.com

description: |
  The QRK3588 eMMC integration uses the SDHCI register interface, five CRU
  clocks and a SYS_GRF card-clock gate. The initial implementation supports
  SDR transfers up to 24 MHz with fixed board supplies.

allOf:
  - $ref: sdhci-common.yaml#

properties:
  compatible:
    const: quest,qrk3588-emmc

  reg:
    maxItems: 1

  interrupts:
    maxItems: 1

  clocks:
    maxItems: 5

  clock-names:
    items:
      - const: card
      - const: ahb
      - const: axi
      - const: base
      - const: timer

  quest,sys-grf:
    $ref: /schemas/types.yaml#/definitions/phandle
    description: SYS_GRF containing the eMMC clock gate and stability controls.

  bus-width:
    const: 8

  max-frequency:
    minimum: 375000
    maximum: 24000000

  non-removable: true
  no-sd: true
  no-sdio: true
  vmmc-supply: true
  vqmmc-supply: true

required:
  - compatible
  - reg
  - interrupts
  - clocks
  - clock-names
  - quest,sys-grf
  - bus-width
  - max-frequency
  - non-removable
  - no-sd
  - no-sdio
  - vmmc-supply
  - vqmmc-supply

unevaluatedProperties: false

examples:
  - |
    #include <dt-bindings/interrupt-controller/arm-gic.h>
    #include <dt-bindings/clock/quest,qrk3588-cru.h>

    mmc@fe2e0000 {
        compatible = "quest,qrk3588-emmc";
        reg = <0xfe2e0000 0x10000>;
        interrupts = <GIC_SPI 205 IRQ_TYPE_LEVEL_HIGH>;
        clocks = <&cru QRK3588_CLK_CCLK_EMMC>,
                 <&cru QRK3588_CLK_HCLK_EMMC>,
                 <&cru QRK3588_CLK_ACLK_EMMC>,
                 <&cru QRK3588_CLK_BCLK_EMMC>,
                 <&cru QRK3588_CLK_TMCLK_EMMC>;
        clock-names = "card", "ahb", "axi", "base", "timer";
        quest,sys-grf = <&sys_grf>;
        bus-width = <8>;
        max-frequency = <24000000>;
        non-removable;
        no-sd;
        no-sdio;
        vmmc-supply = <&vcc_emmc>;
        vqmmc-supply = <&vccq_emmc>;
    };
...
```

## Documentation/devicetree/bindings/pci/quest,qrk3588-pcie.yaml
```yaml
# SPDX-License-Identifier: (GPL-2.0-only OR BSD-2-Clause)
%YAML 1.2
---
$id: http://devicetree.org/schemas/pci/quest,qrk3588-pcie.yaml#
$schema: http://devicetree.org/meta-schemas/core.yaml#

title: Quest QRK3588 DesignWare PCIe host controller

maintainers:
  - ninozhang001@gmail.com

description: |
  The QRK3588 PCIe1L0 and PCIe1L2 root ports use a Synopsys DesignWare PCIe
  controller connected to a single-lane Combo PIPE PHY.  The glue driver owns
  the PHP power-domain wakeup, controller resets, endpoint PERST# signal,
  and link startup. The PHY provider owns PHY clocks, resets and routing.

allOf:
  - $ref: /schemas/pci/pci-host-bridge.yaml#

properties:
  compatible:
    const: quest,qrk3588-pcie

  reg:
    items:
      - description: DesignWare DBI and unrolled iATU registers
      - description: Outbound PCI configuration-space aperture
      - description: PCIe client/APB registers

  reg-names:
    items:
      - const: dbi
      - const: config
      - const: apb

  phys:
    maxItems: 1

  phy-names:
    const: pcie

  quest,pmu:
    $ref: /schemas/types.yaml#/definitions/phandle
    description: Phandle to the shared PMU syscon.

  clocks:
    minItems: 15
    maxItems: 15

  clock-names:
    items:
      - const: core
      - const: pcie-biu
      - const: php-biu
      - const: pcie-bridge
      - const: php-root
      - const: pcie-root
      - const: php-biu-pclk
      - const: php-root-pclk
      - const: mmu-biu
      - const: mmu-pcie
      - const: dbi
      - const: slave
      - const: master
      - const: aux
      - const: pipe

  resets:
    minItems: 2
    maxItems: 2

  reset-names:
    items:
      - const: pipe
      - const: power-up

  reset-gpios:
    description: GPIO driving the downstream endpoint PERST# input.
    maxItems: 1

  num-lanes:
    const: 1

  max-link-speed:
    maximum: 2

required:
  - compatible
  - reg
  - reg-names
  - clocks
  - clock-names
  - resets
  - reset-names
  - reset-gpios
  - num-lanes
  - msi-map
  - phys
  - phy-names
  - quest,pmu

unevaluatedProperties: false

examples:
  - |
    #include <dt-bindings/gpio/gpio.h>

    pcie@f5800000 {
        compatible = "quest,qrk3588-pcie";
        device_type = "pci";
        reg = <0xf5800000 0x00400000>, <0xf2000000 0x00100000>,
              <0xfe170000 0x00010000>;
        reg-names = "dbi", "config", "apb";
        phys = <&combphy1>;
        phy-names = "pcie";
        quest,pmu = <&pmu>;
        clocks = <&cru 12>, <&cru 16>, <&cru 17>, <&cru 18>, <&cru 19>,
                 <&cru 20>, <&cru 21>, <&cru 22>, <&cru 23>, <&cru 24>,
                 <&cru 25>, <&cru 26>, <&cru 27>, <&cru 28>, <&cru 29>;
        clock-names = "core", "pcie-biu", "php-biu", "pcie-bridge",
                      "php-root", "pcie-root", "php-biu-pclk", "php-root-pclk",
                      "mmu-biu", "mmu-pcie", "dbi", "slave", "master", "aux",
                      "pipe";
        resets = <&cru 2>, <&cru 3>;
        reset-names = "pipe", "power-up";
        reset-gpios = <&gpio4 11 GPIO_ACTIVE_LOW>;
        msi-map = <0x0 &its0 0x0 0x10000>;
        bus-range = <0x0 0xff>;
        #address-cells = <3>;
        #size-cells = <2>;
        #interrupt-cells = <1>;
        interrupt-map-mask = <0 0 0 7>;
        interrupt-map = <0 0 0 1 &gic 0 240 4>;
        num-lanes = <1>;
        max-link-speed = <2>;
        ranges = <0x82000000 0 0x01000000 0xf2200000 0 0x01e00000>;
    };
...
```

## Documentation/devicetree/bindings/phy/quest,qrk3588-combo-phy.yaml
```yaml
# SPDX-License-Identifier: (GPL-2.0-only OR BSD-2-Clause)
%YAML 1.2
---
$id: http://devicetree.org/schemas/phy/quest,qrk3588-combo-phy.yaml#
$schema: http://devicetree.org/meta-schemas/core.yaml#

title: Quest QRK3588 Combo PIPE PHY

maintainers:
  - ninozhang001@gmail.com

description: |
  The single-lane Combo PIPE PHYs supply the PCIe controllers. Each PHY
  owns its internal registers, PIPE GRF, reference clock and local resets.
  This binding currently describes operation in PCIe mode.

properties:
  compatible:
    const: quest,qrk3588-combo-phy

  reg:
    items:
      - description: PHY internal registers
      - description: PIPE PHY GRF registers

  reg-names:
    items:
      - const: phy
      - const: grf

  '#phy-cells':
    const: 0

  quest,php-grf:
    $ref: /schemas/types.yaml#/definitions/phandle
    description: |
      PHP GRF syscon for the PHY connected through the PCIe1L0 routing mux.
      When present, select this Combo PHY by clearing PCIESEL_CON bit 0.
      Omit for a PHY with a direct connection to its PCIe controller.

  clocks:
    maxItems: 7

  clock-names:
    items:
      - const: apb
      - const: ref
      - const: phy-ref
      - const: pmalive
      - const: pipe
      - const: pipe-asic
      - const: grf

  resets:
    maxItems: 3

  reset-names:
    items:
      - const: grf
      - const: apb
      - const: core

required:
  - compatible
  - reg
  - reg-names
  - '#phy-cells'
  - clocks
  - clock-names
  - resets
  - reset-names

additionalProperties: false

examples:
  - |
    phy@fee10000 {
        compatible = "quest,qrk3588-combo-phy";
        reg = <0xfee10000 0x10000>, <0xfd5c0000 0x10000>;
        reg-names = "phy", "grf";
        #phy-cells = <0>;
        quest,php-grf = <&php_grf>;
        clocks = <&cru 15>, <&cru 11>, <&cru 40>, <&cru 41>,
                 <&cru 42>, <&cru 43>, <&cru 44>;
        clock-names = "apb", "ref", "phy-ref", "pmalive", "pipe",
                      "pipe-asic", "grf";
        resets = <&cru 9>, <&cru 10>, <&cru 11>;
        reset-names = "grf", "apb", "core";
    };
...
```

## Documentation/devicetree/bindings/pinctrl/quest,qrk3588-pinctrl.yaml
```yaml
# SPDX-License-Identifier: (GPL-2.0-only OR BSD-2-Clause)
%YAML 1.2
---
$id: http://devicetree.org/schemas/pinctrl/quest,qrk3588-pinctrl.yaml#
$schema: http://devicetree.org/meta-schemas/core.yaml#

title: Quest QRK3588 Pin Controller

maintainers:
  - ninozhang001@gmail.com

description:
  The QRK3588 pin controller selects peripheral and GPIO functions through
  the PMU1, PMU2, BUS and eMMC IO-controller register blocks.

properties:
  compatible:
    const: quest,qrk3588-pinctrl

  reg:
    minItems: 4
    maxItems: 4

  reg-names:
    items:
      - const: pmu1-ioc
      - const: pmu2-ioc
      - const: bus-ioc
      - const: emmc-ioc

patternProperties:
  '-pins$':
    type: object
    allOf:
      - $ref: pincfg-node.yaml#
      - $ref: pinmux-node.yaml#
    additionalProperties: false
    properties:
      groups:
        enum:
          - uart2m0
          - emmc-cmd
          - emmc-clk-strobe
          - emmc-rstn
          - emmc-data

      function:
        enum: [ uart2, emmc ]

      bias-disable: true
      bias-pull-down: true
      bias-pull-up: true
      input-enable: true
      input-schmitt-disable: true
      output-impedance-ohms:
        const: 40

    required:
      - groups
      - function

allOf:
  - $ref: pinctrl.yaml#

required:
  - compatible
  - reg
  - reg-names

additionalProperties: false

examples:
  - |
    pinctrl@fd5f0000 {
        compatible = "quest,qrk3588-pinctrl";
        reg = <0xfd5f0000 0x4000>,
              <0xfd5f4000 0x4000>,
              <0xfd5f8000 0x1000>,
              <0xfd5fd000 0x1000>;
        reg-names = "pmu1-ioc", "pmu2-ioc", "bus-ioc", "emmc-ioc";

        uart2m0-pins {
            groups = "uart2m0";
            function = "uart2";
        };
    };
```
